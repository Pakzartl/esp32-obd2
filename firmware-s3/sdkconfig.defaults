## firmware-s3/sdkconfig.defaults
```kconfig
# Target: ESP32-S3
CONFIG_IDF_TARGET="esp32s3"

# Flash
CONFIG_ESPTOOLPY_FLASHSIZE_4MB=y
CONFIG_ESPTOOLPY_FLASHSIZE="4MB"

# Partition
CONFIG_PARTITION_TABLE_CUSTOM=y
CONFIG_PARTITION_TABLE_CUSTOM_FILENAME="partitions.csv"

# BLE — NimBLE peripheral only
CONFIG_BT_ENABLED=y
CONFIG_BT_NIMBLE_ENABLED=y
CONFIG_BT_NIMBLE_MAX_CONNECTIONS=1
CONFIG_BT_NIMBLE_ROLE_PERIPHERAL=y
CONFIG_BT_NIMBLE_ROLE_CENTRAL=n
CONFIG_BT_NIMBLE_ROLE_OBSERVER=n
CONFIG_BT_NIMBLE_ROLE_BROADCASTER=y

# WiFi (for ESP-NOW, not connecting to AP)
CONFIG_ESP_WIFI_STATIC_RX_BUFFER_NUM=4
CONFIG_ESP_WIFI_DYNAMIC_RX_BUFFER_NUM=8

# WiFi + BLE coexistence
CONFIG_ESP_COEX_SW_COEXIST_ENABLE=y

# BLE connection parameters (PPCP)
CONFIG_BT_NIMBLE_SVC_GAP_PPCP_MIN_CONN_INTERVAL=36
CONFIG_BT_NIMBLE_SVC_GAP_PPCP_MAX_CONN_INTERVAL=36
CONFIG_BT_NIMBLE_SVC_GAP_PPCP_SLAVE_LATENCY=0
CONFIG_BT_NIMBLE_SVC_GAP_PPCP_SUPERVISION_TMO=400

# OTA (dual partition for future OTA)
CONFIG_BOOTLOADER_APP_ROLLBACK_ENABLE=y

# USB console (S3 native USB)
CONFIG_ESP_CONSOLE_USB_SERIAL_JTAG=y

# ESP-NOW
CONFIG_ESP_WIFI_ESPNOW_MAX_ENCRYPT_NUM=0

# HTTP Server (for WiFi config portal)
CONFIG_HTTPD_MAX_REQ_HDR_LEN=512
CONFIG_HTTPD_MAX_URI_LEN=512
```

## firmware/main/Kconfig.projbuild
```kconfig
menu "ADV350 Configuration"

    config WIFI_SSID
        string "WiFi SSID"
        default "myssid"

    config WIFI_PASS
        string "WiFi Password"
        default "mypassword"

    choice DEFAULT_MODE
        prompt "Default boot mode"
        default DEFAULT_MODE_DEV

        config DEFAULT_MODE_DEV
            bool "DEV (WiFi + OTA)"

        config DEFAULT_MODE_PROD
            bool "PRODUCTION (BLE + CAN)"

    endchoice

endmenu
```

## firmware/sdkconfig.defaults
```kconfig
CONFIG_ESP_MAIN_TASK_STACK_SIZE=8192
CONFIG_ESP_SYSTEM_EVENT_TASK_STACK_SIZE=4096
CONFIG_FREERTOS_IDLE_TASK_STACKSIZE=4096
CONFIG_PTHREAD_TASK_STACK_SIZE_DEFAULT=4096

# PSRAM (Octal, 8MB on N16R8)
CONFIG_SPIRAM=y
CONFIG_SPIRAM_MODE_OCT=y
CONFIG_SPIRAM_SPEED_80M=y
CONFIG_SPIRAM_USE_MALLOC=y
CONFIG_SPIRAM_MALLOC_ALWAYSINTERNAL=16384

# Flash (16MB on N16R8)
CONFIG_ESPTOOLPY_FLASHSIZE_16MB=y
CONFIG_ESPTOOLPY_FLASHSIZE="16MB"

# Compiler
CONFIG_COMPILER_OPTIMIZATION_PERF=y

# Logging
CONFIG_LOG_DEFAULT_LEVEL_INFO=y

# LED Strip (WS2812)
CONFIG_SOC_RMT_SUPPORTED=y
```

## poc-can-sniffer/main/Kconfig.projbuild
```kconfig
menu "ADV350 Configuration"

    config WIFI_SSID
        string "WiFi SSID"
        default "myssid"

    config WIFI_PASS
        string "WiFi Password"
        default "mypassword"

endmenu
```

## poc-can-sniffer/sdkconfig.defaults
```kconfig
CONFIG_ESPTOOLPY_FLASHSIZE_4MB=y
CONFIG_ESPTOOLPY_FLASHSIZE="4MB"
CONFIG_LOG_DEFAULT_LEVEL_INFO=y
CONFIG_ESP_MAIN_TASK_STACK_SIZE=8192

# Custom OTA partition table
CONFIG_PARTITION_TABLE_CUSTOM=y
CONFIG_PARTITION_TABLE_CUSTOM_FILENAME="partitions.csv"

# Rollback support
CONFIG_BOOTLOADER_APP_ROLLBACK_ENABLE=y
CONFIG_BOOTLOADER_WDT_ENABLE=y
CONFIG_BOOTLOADER_WDT_TIME_MS=9000

# WiFi credentials (override in sdkconfig.local)
CONFIG_WIFI_SSID="myssid"
CONFIG_WIFI_PASS="mypassword"

# BLE controller — ESP32 original chip
CONFIG_BT_ENABLED=y
CONFIG_BTDM_CTRL_MODE_BLE_ONLY=y
CONFIG_BTDM_CTRL_BLE_MAX_CONN=1
CONFIG_BTDM_CTRL_MODEM_SLEEP=n

# NimBLE host
CONFIG_BT_NIMBLE_ENABLED=y
CONFIG_BT_NIMBLE_MAX_CONNECTIONS=1
CONFIG_BT_NIMBLE_ROLE_BROADCASTER=y
CONFIG_BT_NIMBLE_ROLE_PERIPHERAL=y
CONFIG_BT_NIMBLE_ROLE_CENTRAL=n
CONFIG_BT_NIMBLE_ROLE_OBSERVER=n
CONFIG_BT_NIMBLE_HOST_TASK_STACK_SIZE=8192
CONFIG_BT_NIMBLE_NVS_PERSIST=n
CONFIG_BT_NIMBLE_MAX_BONDS=0
CONFIG_BT_NIMBLE_SM_SC=n
CONFIG_BT_NIMBLE_SM_LEGACY=n
CONFIG_BT_NIMBLE_SECURITY_ENABLE=n
CONFIG_BT_NIMBLE_MEM_ALLOC_MODE_INTERNAL=y

# TWAI (CAN) errata fixes
CONFIG_TWAI_ERRATA_FIX_BUS_OFF_REC=y
CONFIG_TWAI_ERRATA_FIX_TX_INTR_LOST=y
CONFIG_TWAI_ERRATA_FIX_RX_FRAME_INVALID=y
CONFIG_TWAI_ERRATA_FIX_RX_FIFO_CORRUPT=y
CONFIG_TWAI_ERRATA_FIX_LISTEN_ONLY_DOM=y

# Brownout: disabled for bench testing (FT232 power insufficient for BLE radio peak)
# Re-enable on vehicle with 12V→3.3V buck: CONFIG_ESP_BROWNOUT_DET=y
CONFIG_ESP_BROWNOUT_DET=n
```
